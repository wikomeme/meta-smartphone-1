## meta-lg/conf/machine/hammerhead.conf
```bitbake
#-----------------------------------------------------------------------------
#@TYPE: Machine
#@NAME: LG Nexus 5 (codename hammerhead)
#@DESCRIPTION: Machine configuration for the LG Nexus 5
#-----------------------------------------------------------------------------

TARGET_ARCH = "arm"

PREFERRED_PROVIDER_virtual/kernel ?= "linux-lg-hammerhead"
MACHINE_KERNEL_PR = "r0"

MACHINE_FEATURES = "kernel26 apm alsa bluetooth gps usbgadget usbhost phone wifi vfat ext2 keyboard nfc"
MACHINE_DISPLAY_WIDTH_PIXELS = "1920"
MACHINE_DISPLAY_HEIGHT_PIXELS = "1080"
MACHINE_DISPLAY_ORIENTATION = "0"
MACHINE_DISPLAY_PPI = "445"

PREFERRED_PROVIDER_virtual/libgl ?= "mesa"
PREFERRED_PROVIDER_virtual/libgbm ?= "mesa"
PREFERRED_PROVIDER_virtual/egl ?= "mesa"
PREFERRED_PROVIDER_virtual/mesa ?= "mesa"
PREFERRED_PROVIDER_virtual/libgles1 ?= "mesa"
PREFERRED_PROVIDER_virtual/libgles2 ?= "mesa"
PREFERRED_PROVIDER_libgbm ?= "mesa"

# Not using Halium, it's a mainline kernel
VIRTUAL-RUNTIME_android-initramfs-scripts = "initramfs-scripts-android"

PREFERRED_PROVIDER_virtual/xserver = "xserver-xorg"
XSERVER = " \
    xserver-xorg \
    xf86-input-evdev \
    xf86-video-fbdev \
"

# We need fsck.vfat for vfat partitions we need to mount
# Also, include the wlan module for the kernel
MACHINE_EXTRA_RDEPENDS = " \
    android-kernel-bootimg \
    dosfstools \
"

# For Nexus 5, we need to build the dtb together with the zImage
KERNEL_IMAGETYPE = "zImage"
KERNEL_DEVICETREE = "qcom-msm8974-lge-nexus5-hammerhead.dtb"
IMAGE_FSTYPES += "tar.gz ext4"
IMAGE_ROOTFS_EXTRA_SPACE = "200000"

ANDROID_BOOTIMG_CMDLINE = "msm.vram=200m cma=300m g_mass_storage.removable=y LUNEOS_NO_OUTPUT_REDIRECT"
#ANDROID_BOOTIMG_CMDLINE = "androidboot.hardware=hammerhead user_debug=31 maxcpus=2 msm_watchdog_v2.enable=1"
#ANDROID_BOOTIMG_CMDLINE = "androidboot.hardware=hammerhead user_debug=31 maxcpus=2 msm_watchdog_v2.enable=1 cma=1024m msm.vram=778m g_mass_storage.removable=y"

ANDROID_BOOTIMG_RAM_BASE = "0x00000000"
ANDROID_BOOTIMG_KERNEL_RAM_BASE = "0x00008000"
ANDROID_BOOTIMG_RAMDISK_RAM_BASE = "0x02900000"
ANDROID_BOOTIMG_SECOND_RAM_BASE = "0x00f00000"
ANDROID_BOOTIMG_TAGS_RAM_BASE = "0x02700000"
ANDROID_EXTRA_INITRAMFS_IMAGE_INSTALL = ""

ANDROID_BOARD_BOOTIMAGE_PARTITION = "/dev/block/mmcblk0p19"
ANDROID_BOARD_SYSTEMIMAGE_PARTITION_SIZE = "1073741824"
ANDROID_BOARD_FLASH_BLOCK_SIZE = "131072"

SERIAL_CONSOLE = "115200 ttyHSL0"

require conf/machine/include/tune-cortexa8.inc
```
